// SPDX-License-Identifier: (GPL-2.0+ OR MIT)
/*
 * Copyright (c) 2020 Rockchip Electronics Co., Ltd.
 *
 */

#include "rk3568-lubancat-dsi0-rpi.dtsi"

&route_dsi0 {
	status = "okay";
	connect = <&vp0_out_dsi0>;
};

&dsi0_in_vp0 {
	status = "okay";
};

&dsi0_in_vp1 {
	status = "disabled";
};
